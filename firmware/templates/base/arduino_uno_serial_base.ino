/*
 * Arduino Uno R3/R4 - Serial Communication Base Template (v5 Clean)
 * Delimited text format only - no JSON parsing
 * Generated by Hydroponics v5 Firmware Generator
 */

// GENERATOR_INCLUDES_PLACEHOLDER

// === CONFIGURATION ===
#define SERIAL_BAUD 9600
#define FIRMWARE_VERSION "1.0-v5"

// === CAPABILITIES ===
// GENERATOR_CAPABILITIES_ARRAY_PLACEHOLDER

// === GLOBALS ===
// GENERATOR_GLOBALS_PLACEHOLDER

// === RESET FUNCTION ===
void(* resetFunc) (void) = 0;

// === UTILITY FUNCTIONS ===
int freeMemory() {
  extern int __heap_start, *__brkval;
  int v;
  return (int) &v - (__brkval == 0 ? (int) &__heap_start : (int) __brkval);
}

// === PIN PARSER (v5 Label_GPIO Format) ===
int parsePin(String pinStr) {
  int underscoreIndex = pinStr.indexOf('_');
  if (underscoreIndex != -1) {
    // Format: Label_GPIO (e.g. D4_2)
    String gpioStr = pinStr.substring(underscoreIndex + 1);
    return gpioStr.toInt();
  }
  // Fallback: Try parsing as integer directly
  if (isDigit(pinStr.charAt(0))) {
      return pinStr.toInt();
  }
  return -1;
}

// GENERATOR_FUNCTIONS_PLACEHOLDER

// === SETUP ===
void setup() {
  Serial.begin(SERIAL_BAUD);
  while (!Serial) {
    ; // Wait for serial port to connect
  }
  Serial.println("{\"ok\":1,\"msg\":\"Arduino Uno Ready\"}");
}

// === MAIN LOOP ===
void loop() {
  if (Serial.available() > 0) {
    String input = Serial.readStringUntil('\n');
    input.trim();

    if (input.length() > 0) {
      String response = processCommand(input);
      Serial.println(response);
    } else {
      while(Serial.available() > 0) {
        Serial.read();
      }
    }
  }
}



// === COMMAND PARSER (v5 Delimited Text Only) ===
String processCommand(String input) {
  char cmdBuffer[120];
  strncpy(cmdBuffer, input.c_str(), sizeof(cmdBuffer) - 1);
  cmdBuffer[sizeof(cmdBuffer) - 1] = '\0';
  
  // Find delimiter position and isolate command name
  char* delimiter = strchr(cmdBuffer, '|');
  if (delimiter) {
    *delimiter = '\0';  // Terminate string at delimiter to isolate command
  }
  const char* cmd = cmdBuffer;
  
  // === SYSTEM COMMANDS ===
  
  if (strcmp(cmd, "PING") == 0) {
    return F("{\"ok\":1,\"pong\":1}");
  }
  
  else if (strcmp(cmd, "INFO") == 0) {
    String response = F("{\"ok\":1,\"up\":");
    response += millis();
    response += F(",\"mem\":");
    response += freeMemory();
    response += F(",\"ver\":\"");
    response += FIRMWARE_VERSION;
    response += F("\",\"capabilities\":[");
    for (int i = 0; i < CAPABILITIES_COUNT; i++) {
      response += "\"";
      response += CAPABILITIES[i];
      response += "\"";
      if (i < CAPABILITIES_COUNT - 1) response += ",";
    }
    response += F("]}");
    return response;
  }
  
  else if (strcmp(cmd, "STATUS") == 0) {
    String response = F("{\"ok\":1,\"status\":\"running\",\"up\":");
    response += millis();
    response += F("}");
    return response;
  }
  
  else if (strcmp(cmd, "RESET") == 0) {
    Serial.println("{\"ok\":1,\"msg\":\"Resetting...\"}");
    delay(100);
    resetFunc();
    return "{\"ok\":1,\"msg\":\"Resetting\"}";
  }
  
  // GENERATOR_DISPATCHER_PLACEHOLDER
  
  else {
    return F("{\"ok\":0,\"error\":\"ERR_INVALID_COMMAND\"}");
  }
}
